## configs/buildroot_2019.05_defconfig
```kconfig
BR2_riscv=y
BR2_WGET="wget -c --passive-ftp -nd -t 3"
BR2_KERNEL_HEADERS_CUSTOM_GIT=y
BR2_KERNEL_HEADERS_CUSTOM_REPO_URL="/labs/linux-lab/linux-stable"
BR2_KERNEL_HEADERS_CUSTOM_REPO_VERSION="v5.1"
BR2_TARGET_GENERIC_HOSTNAME="linux-lab"
BR2_TARGET_GENERIC_ISSUE="Welcome to Linux Lab"
BR2_TARGET_GENERIC_GETTY_PORT="ttyS0"
BR2_PACKAGE_BUSYBOX_SHOW_OTHERS=y
BR2_PACKAGE_BASH=y
BR2_TARGET_ROOTFS_CPIO=y
BR2_TARGET_ROOTFS_CPIO_GZIP=y
BR2_TARGET_ROOTFS_EXT2=y
BR2_TARGET_ROOTFS_EXT2_GZIP=y
BR2_TARGET_OPENSBI=y
BR2_TARGET_OPENSBI_PLAT="qemu/virt"
```
